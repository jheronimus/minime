// SPDX-License-Identifier: (GPL-2.0+ OR MIT)
/dts-v1/;
#include "rk3326-anbernic-rg351m.dtsi"

/ {
	model = "Anbernic RG351P";
	compatible = "anbernic,rg351p", "rockchip,rk3326";
};

&internal_display {
	compatible = "elida,kd35t133";
	iovcc-supply = <&vcc_lcd>;
	rotation = <270>;
	vdd-supply = <&vcc_lcd>;
};
