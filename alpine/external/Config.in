## alpine/external/Config.in
```kconfig
source "$BR2_EXTERNAL_MINIME_PATH/package/libmali/Config.in"
source "$BR2_EXTERNAL_MINIME_PATH/package/mali-kbase/Config.in"
```

## alpine/external/configs/minime_h700_defconfig
```kconfig
BR2_aarch64=y
BR2_TOOLCHAIN_EXTERNAL=y
BR2_TOOLCHAIN_EXTERNAL_ARM_AARCH64=y
BR2_TARGET_LDFLAGS="-fuse-ld=mold"
BR2_DL_DIR="~/.buildroot-dl"
BR2_CCACHE=y
BR2_CCACHE_DIR="~/.buildroot-ccache"
BR2_CCACHE_INITIAL_SETUP="--max-size=30G"
BR2_OPTIMIZE_3=y
BR2_ENABLE_LTO=y
BR2_GLOBAL_PATCH_DIR="$(BR2_EXTERNAL_MINIME_PATH)/board/common/patches $(BR2_EXTERNAL_MINIME_PATH)/board/h700/patches"
BR2_TARGET_GENERIC_HOSTNAME="minime"
BR2_ROOTFS_DEVICE_CREATION_DYNAMIC_EUDEV=y
BR2_TARGET_GENERIC_ROOT_PASSWD="root"
BR2_ROOTFS_OVERLAY="$(BR2_EXTERNAL_MINIME_PATH)/board/common/overlay"
BR2_ROOTFS_POST_BUILD_SCRIPT="$(BR2_EXTERNAL_MINIME_PATH)/board/common/post-build.sh"
BR2_ROOTFS_POST_IMAGE_SCRIPT="$(BR2_EXTERNAL_MINIME_PATH)/board/common/post-image.sh"
BR2_ROOTFS_POST_SCRIPT_ARGS="-c $(BR2_EXTERNAL_MINIME_PATH)/board/h700/genimage.cfg"
BR2_LINUX_KERNEL=y
BR2_LINUX_KERNEL_CUSTOM_VERSION=y
BR2_LINUX_KERNEL_CUSTOM_VERSION_VALUE="7.0.10"
BR2_LINUX_KERNEL_USE_CUSTOM_CONFIG=y
BR2_LINUX_KERNEL_CUSTOM_CONFIG_FILE="$(BR2_EXTERNAL_MINIME_PATH)/board/common/tiny-base.config"
BR2_LINUX_KERNEL_CONFIG_FRAGMENT_FILES="$(BR2_EXTERNAL_MINIME_PATH)/board/h700/tiny-h700.config"
BR2_LINUX_KERNEL_DTS_SUPPORT=y
BR2_LINUX_KERNEL_INTREE_DTS_NAME="allwinner/sun50i-h700-anbernic-rg28xx allwinner/sun50i-h700-anbernic-rg34xx allwinner/sun50i-h700-anbernic-rg34xx-sp allwinner/sun50i-h700-anbernic-rg35xx-2024 allwinner/sun50i-h700-anbernic-rg35xx-2024-rev6-panel allwinner/sun50i-h700-anbernic-rg35xx-h allwinner/sun50i-h700-anbernic-rg35xx-h-rev6-panel allwinner/sun50i-h700-anbernic-rg35xx-plus allwinner/sun50i-h700-anbernic-rg35xx-plus-rev6-panel allwinner/sun50i-h700-anbernic-rg35xx-pro allwinner/sun50i-h700-anbernic-rg35xx-sp allwinner/sun50i-h700-anbernic-rg35xx-sp-v2-panel allwinner/sun50i-h700-anbernic-rg40xx-h allwinner/sun50i-h700-anbernic-rg40xx-h-v2-panel allwinner/sun50i-h700-anbernic-rg40xx-v allwinner/sun50i-h700-anbernic-rg40xx-v-v2-panel allwinner/sun50i-h700-anbernic-rgcubexx"
BR2_PACKAGE_BUSYBOX_CONFIG_FRAGMENT_FILES="$(BR2_EXTERNAL_MINIME_PATH)/board/common/busybox.config"
BR2_PACKAGE_PANFROST=y
BR2_PACKAGE_WIRELESS_REGDB=y
BR2_PACKAGE_WPA_SUPPLICANT=y
BR2_PACKAGE_WPA_SUPPLICANT_CLI=y
BR2_PACKAGE_MDNSD=y
BR2_PACKAGE_UTIL_LINUX_PARTX=y
BR2_TARGET_ROOTFS_TAR=y

BR2_TARGET_ARM_TRUSTED_FIRMWARE=y
BR2_TARGET_ARM_TRUSTED_FIRMWARE_CUSTOM_VERSION=y
BR2_TARGET_ARM_TRUSTED_FIRMWARE_CUSTOM_VERSION_VALUE="v2.15.0"
BR2_TARGET_ARM_TRUSTED_FIRMWARE_PLATFORM="sun50i_h616"
BR2_TARGET_UBOOT=y
BR2_TARGET_UBOOT_BUILD_SYSTEM_KCONFIG=y
BR2_TARGET_UBOOT_CUSTOM_VERSION=y
BR2_TARGET_UBOOT_CUSTOM_VERSION_VALUE="2026.04"
BR2_TARGET_UBOOT_BOARD_DEFCONFIG="anbernic_rg35xx_h700"
BR2_TARGET_UBOOT_CONFIG_FRAGMENT_FILES="$(BR2_EXTERNAL_MINIME_PATH)/board/h700/uboot.config"
BR2_TARGET_UBOOT_NEEDS_DTC=y
BR2_TARGET_UBOOT_NEEDS_PYLIBFDT=y
BR2_TARGET_UBOOT_NEEDS_OPENSSL=y
BR2_TARGET_UBOOT_NEEDS_ATF_BL31=y
BR2_TARGET_UBOOT_SPL=y
BR2_TARGET_UBOOT_SPL_NAME="u-boot-sunxi-with-spl.bin"
# Bluetooth support
BR2_PACKAGE_DBUS=y
BR2_PACKAGE_BLUEZ5_UTILS=y
BR2_PACKAGE_BLUEZ5_UTILS_CLIENT=y
BR2_PACKAGE_BLUEZ5_UTILS_PLUGINS_HID=y
BR2_PACKAGE_BLUEZ5_UTILS_PLUGINS_AUDIO=y
BR2_PACKAGE_BLUEZ_ALSA=y
BR2_PACKAGE_DOSFSTOOLS=y
BR2_PACKAGE_DOSFSTOOLS_MKFS_FAT=y

# Media and graphics libraries
BR2_PACKAGE_ZSTD=y
BR2_PACKAGE_LIBXML2=y
BR2_PACKAGE_LIBFFI=y
BR2_PACKAGE_LIBEDIT=y
BR2_PACKAGE_SDL2=y
BR2_PACKAGE_SDL2_KMSDRM=y
BR2_PACKAGE_SDL2_OPENGLES=y
BR2_PACKAGE_LIBPNG=y
BR2_PACKAGE_SDL2_IMAGE=y
BR2_PACKAGE_SDL2_TTF=y

# MinUI overlay
BR2_PACKAGE_MINUI=y
BR2_PACKAGE_MINUI_EXTRAS=y
BR2_PACKAGE_DRKHRSE_MIYOO_BEZELS=y
```

## alpine/external/configs/minime_rk3566_defconfig
```kconfig
BR2_aarch64=y
BR2_cortex_a55=y
BR2_TOOLCHAIN_EXTERNAL=y
BR2_TOOLCHAIN_EXTERNAL_ARM_AARCH64=y
BR2_TARGET_LDFLAGS="-fuse-ld=mold"
BR2_DL_DIR="~/.buildroot-dl"
BR2_CCACHE=y
BR2_CCACHE_DIR="~/.buildroot-ccache"
BR2_CCACHE_INITIAL_SETUP="--max-size=30G"
BR2_OPTIMIZE_3=y
BR2_ENABLE_LTO=y
BR2_GLOBAL_PATCH_DIR="$(BR2_EXTERNAL_MINIME_PATH)/board/rk3566/patches"
BR2_TARGET_GENERIC_HOSTNAME="minime"
BR2_ROOTFS_DEVICE_CREATION_DYNAMIC_EUDEV=y
BR2_TARGET_GENERIC_ROOT_PASSWD="root"
BR2_ROOTFS_OVERLAY="$(BR2_EXTERNAL_MINIME_PATH)/board/rk3566/overlay"
BR2_ROOTFS_POST_BUILD_SCRIPT="$(BR2_EXTERNAL_MINIME_PATH)/board/rk3566/post-build.sh"
BR2_ROOTFS_POST_IMAGE_SCRIPT="$(BR2_EXTERNAL_MINIME_PATH)/board/rk3566/post-image.sh"
BR2_ROOTFS_POST_SCRIPT_ARGS="-c $(BR2_EXTERNAL_MINIME_PATH)/board/rk3566/genimage.cfg"
BR2_LINUX_KERNEL=y
BR2_LINUX_KERNEL_CUSTOM_VERSION=y
BR2_LINUX_KERNEL_CUSTOM_VERSION_VALUE="7.0.10"
BR2_LINUX_KERNEL_USE_CUSTOM_CONFIG=y
BR2_LINUX_KERNEL_CUSTOM_CONFIG_FILE="$(BR2_EXTERNAL_MINIME_PATH)/board/tiny-base.config"
BR2_LINUX_KERNEL_CONFIG_FRAGMENT_FILES="$(BR2_EXTERNAL_MINIME_PATH)/board/rk3566/tiny-rk3566.config"
BR2_LINUX_KERNEL_DTS_SUPPORT=y
BR2_LINUX_KERNEL_INTREE_DTS_NAME="rockchip/rk3566-anbernic-rg-arc-d rockchip/rk3566-anbernic-rg-arc-s rockchip/rk3566-anbernic-rg353p rockchip/rk3566-anbernic-rg353ps rockchip/rk3566-anbernic-rg353v rockchip/rk3566-anbernic-rg353vs rockchip/rk3566-anbernic-rg503 rockchip/rk3568-anbernic-rg-ds"
BR2_PACKAGE_BUSYBOX_CONFIG_FRAGMENT_FILES="$(BR2_EXTERNAL_MINIME_PATH)/board/rk3566/busybox.config"
BR2_PACKAGE_LIBMALI=y
BR2_PACKAGE_LIBMALI_GPU_BIFROST_G52=y
BR2_PACKAGE_MALI_KBASE=y
BR2_PACKAGE_WIRELESS_REGDB=y
BR2_PACKAGE_WPA_SUPPLICANT=y
BR2_PACKAGE_WPA_SUPPLICANT_CLI=y
BR2_PACKAGE_UTIL_LINUX_PARTX=y
BR2_TARGET_ROOTFS_TAR=y
BR2_TARGET_ARM_TRUSTED_FIRMWARE=y
BR2_TARGET_ARM_TRUSTED_FIRMWARE_PLATFORM="rk3568"
BR2_TARGET_UBOOT=y
BR2_TARGET_UBOOT_BUILD_SYSTEM_KCONFIG=y
BR2_TARGET_UBOOT_CUSTOM_VERSION=y
BR2_TARGET_UBOOT_CUSTOM_VERSION_VALUE="2026.04"
BR2_TARGET_UBOOT_BOARD_DEFCONFIG="anbernic-rgxx3-rk3566"
BR2_TARGET_UBOOT_CONFIG_FRAGMENT_FILES="$(BR2_EXTERNAL_MINIME_PATH)/board/rk3566/uboot.config"
BR2_TARGET_UBOOT_NEEDS_DTC=y
BR2_TARGET_UBOOT_NEEDS_PYLIBFDT=y
BR2_TARGET_UBOOT_NEEDS_OPENSSL=y
BR2_TARGET_UBOOT_NEEDS_ATF_BL31=y
BR2_TARGET_UBOOT_FORMAT_ITB=y
BR2_TARGET_UBOOT_SPL=y
BR2_PACKAGE_HOST_EROFS_UTILS=y
BR2_PACKAGE_HOST_GENIMAGE=y
BR2_PACKAGE_HOST_UBOOT_TOOLS=y
BR2_PACKAGE_HOST_MTOOLS=y
BR2_PACKAGE_HOST_DOSFSTOOLS=y

# Bluetooth support
BR2_PACKAGE_DBUS=y
BR2_PACKAGE_BLUEZ5_UTILS=y
BR2_PACKAGE_BLUEZ5_UTILS_CLIENT=y
BR2_PACKAGE_BLUEZ5_UTILS_PLUGINS_HID=y
BR2_PACKAGE_BLUEZ5_UTILS_PLUGINS_AUDIO=y
BR2_PACKAGE_BLUEZ_ALSA=y
BR2_PACKAGE_DOSFSTOOLS=y
BR2_PACKAGE_DOSFSTOOLS_MKFS_FAT=y

# Media and graphics libraries
BR2_PACKAGE_SDL2=y
BR2_PACKAGE_SDL2_IMAGE=y
BR2_PACKAGE_SDL2_IMAGE_PNG=y
BR2_PACKAGE_SDL2_TTF=y

# MinUI overlay
BR2_PACKAGE_MINUI=y
BR2_PACKAGE_MINUI_EXTRAS=y
BR2_PACKAGE_DRKHRSE_MIYOO_BEZELS=y
```

## alpine/external/package/allium-themes/Config.in
```kconfig
config BR2_PACKAGE_ALLIUM_THEMES
	bool "allium themes"
	help
	  Official Allium theme collection.

	  https://github.com/goweiwen/Allium-Themes
```

## alpine/external/package/host-llvm-system/Config.in
```kconfig
config BR2_PACKAGE_HOST_LLVM_SYSTEM
	bool "host llvm (system)"
	help
	  Use the Debian build container's preinstalled LLVM/Clang/libclc
	  toolchain (LLVM 22 from apt.llvm.org) instead of building
	  host-llvm, host-clang and host-libclc from source.

	  Requires llvm-22, llvm-22-dev, clang-22, clang-tools-22,
	  libllvm22, libclang1-22, libclang-cpp22, libclang-common-22-dev,
	  libclang-22-dev and libclc-22-dev to be installed in the
	  container image.

config BR2_PACKAGE_PROVIDES_HOST_LLVM
	string
	default "host-llvm-system" if BR2_PACKAGE_HOST_LLVM_SYSTEM

config BR2_PACKAGE_PROVIDES_HOST_CLANG
	string
	default "host-llvm-system" if BR2_PACKAGE_HOST_LLVM_SYSTEM

config BR2_PACKAGE_PROVIDES_HOST_LIBCLC
	string
	default "host-llvm-system" if BR2_PACKAGE_HOST_LLVM_SYSTEM
```

## alpine/external/package/libmali/Config.in
```kconfig
config BR2_PACKAGE_LIBMALI
	bool "libmali"
	depends on BR2_aarch64
	select BR2_PACKAGE_HAS_LIBEGL
	select BR2_PACKAGE_HAS_LIBGLES
	select BR2_PACKAGE_HAS_LIBGBM
	select BR2_PACKAGE_LIBDRM
	help
	  Proprietary ARM Mali user-space driver wrappers.
	  Provides OpenGL ES, EGL, and GBM libraries.

if BR2_PACKAGE_LIBMALI

config BR2_PACKAGE_PROVIDES_LIBEGL
	default "libmali"

config BR2_PACKAGE_PROVIDES_LIBGLES
	default "libmali"

config BR2_PACKAGE_PROVIDES_LIBGBM
	default "libmali"

endif
```

## alpine/external/package/mali-kbase/Config.in
```kconfig
config BR2_PACKAGE_MALI_KBASE
	bool "mali-kbase"
	depends on BR2_LINUX_KERNEL
	help
	  Kernel-space driver module for ARM Mali Bifrost GPU.

comment "mali-kbase needs a Linux kernel to be built"
	depends on !BR2_LINUX_KERNEL
```

## alpine/external/package/mesa3d-panfrost-prebuilt/Config.in
```kconfig
config BR2_PACKAGE_MESA3D_PANFROST_PREBUILT
	bool "mesa3d-panfrost-prebuilt"
	depends on BR2_aarch64
	help
	  Precompiled Mesa (Panfrost) + LLVM binaries for dynamic switching.
```

## alpine/external/package/minui/Config.in
```kconfig
################################################################################
#
# minui
#
################################################################################

config BR2_PACKAGE_MINUI
	bool "minui"
	select BR2_PACKAGE_DBUS
	select BR2_PACKAGE_LZ4
	select BR2_PACKAGE_LIBRETRO_COMMON
	select BR2_PACKAGE_SDL2
	select BR2_PACKAGE_SDL2_IMAGE
	select BR2_PACKAGE_SDL2_TTF
	select BR2_PACKAGE_ZLIB
	help
	  Minimal launcher frontend and UI shell for minime.

	  https://github.com/minime-os/minui
```

## alpine/external/package/panfrost/Config.in
```kconfig
config BR2_PACKAGE_PANFROST
	bool "panfrost"
	depends on BR2_aarch64
	select BR2_PACKAGE_HAS_LIBEGL
	select BR2_PACKAGE_HAS_LIBGLES
	select BR2_PACKAGE_HAS_LIBGBM
	select BR2_PACKAGE_LIBDRM
	select BR2_PACKAGE_MESA3D_HEADERS
	help
	  Precompiled Mesa (Panfrost) + LLVM binaries
	  for dynamic switching.

if BR2_PACKAGE_PANFROST

config BR2_PACKAGE_PROVIDES_LIBEGL
	default "panfrost"

config BR2_PACKAGE_PROVIDES_LIBGLES
	default "panfrost"

config BR2_PACKAGE_PROVIDES_LIBGBM
	default "panfrost"

endif
```

## alpine/external/package/retroarch-cores/Config.in
```kconfig
config BR2_PACKAGE_RETROARCH_CORES
	bool "retroarch-cores"
	select BR2_PACKAGE_ZLIB
	help
	  Centralized RetroArch/libretro cores package for minime.
	  Builds a set of popular cores from source.
```

## alpine/external/package/retroarch-frontend/Config.in
```kconfig
config BR2_PACKAGE_RETROARCH_FRONTEND
	bool "retroarch-frontend"
	select BR2_PACKAGE_RETROARCH_CORES
	select BR2_PACKAGE_SDL2
	select BR2_PACKAGE_SDL2_KMSDRM
	select BR2_PACKAGE_SDL2_OPENGLES
	select BR2_PACKAGE_ALSA_LIB
	select BR2_PACKAGE_ZLIB
	help
	  RetroArch frontend for minime.
```

## buildroot/external/Config.in
```kconfig
source "$BR2_EXTERNAL_MINIME_PATH/package/libretro-headers/Config.in"
source "$BR2_EXTERNAL_MINIME_PATH/package/libmali/Config.in"
source "$BR2_EXTERNAL_MINIME_PATH/package/mali-kbase/Config.in"

choice
	prompt "Minime user interface"
	optional

source "$BR2_EXTERNAL_MINIME_PATH/package/minui/Config.in"
source "$BR2_EXTERNAL_MINIME_PATH/package/allium/Config.in"

endchoice

source "$BR2_EXTERNAL_MINIME_PATH/package/fatresize/Config.in"

source "$BR2_EXTERNAL_MINIME_PATH/package/drkhrse-miyoo-bezels/Config.in"
source "$BR2_EXTERNAL_MINIME_PATH/package/preloaded-roms/Config.in"
source "$BR2_EXTERNAL_MINIME_PATH/package/libretro-cores/Config.in"
source "$BR2_EXTERNAL_MINIME_PATH/package/retroarch/Config.in"
source "$BR2_EXTERNAL_MINIME_PATH/package/bootsplash/Config.in"
```

## buildroot/external/configs/minime_rk3326_defconfig
```kconfig
BR2_aarch64=y
BR2_cortex_a35=y
BR2_TOOLCHAIN_EXTERNAL=y
BR2_TOOLCHAIN_EXTERNAL_ARM_AARCH64=y
BR2_TARGET_LDFLAGS="-fuse-ld=mold"
BR2_DL_DIR="~/.buildroot-dl"
BR2_CCACHE=y
BR2_CCACHE_DIR="~/.buildroot-ccache"
BR2_CCACHE_INITIAL_SETUP="--max-size=30G"
BR2_OPTIMIZE_3=y
BR2_ENABLE_LTO=y
BR2_GLOBAL_PATCH_DIR="$(BR2_EXTERNAL_MINIME_PATH)/board/common/patches $(BR2_EXTERNAL_MINIME_PATH)/board/rk3326/patches"
BR2_TARGET_GENERIC_HOSTNAME="minime"
BR2_ROOTFS_DEVICE_CREATION_DYNAMIC_EUDEV=y
BR2_TARGET_GENERIC_ROOT_PASSWD="root"
BR2_ROOTFS_OVERLAY="$(BR2_EXTERNAL_MINIME_PATH)/board/common/overlay"
BR2_ROOTFS_POST_BUILD_SCRIPT="$(BR2_EXTERNAL_MINIME_PATH)/board/common/post-build.sh"
BR2_ROOTFS_POST_IMAGE_SCRIPT="$(BR2_EXTERNAL_MINIME_PATH)/board/common/post-image.sh"
BR2_ROOTFS_POST_SCRIPT_ARGS="-c $(BR2_EXTERNAL_MINIME_PATH)/board/rk3326/genimage.cfg"
BR2_LINUX_KERNEL=y
BR2_LINUX_KERNEL_CUSTOM_VERSION=y
BR2_LINUX_KERNEL_CUSTOM_VERSION_VALUE="7.0.10"
BR2_LINUX_KERNEL_USE_CUSTOM_CONFIG=y
BR2_LINUX_KERNEL_CUSTOM_CONFIG_FILE="$(BR2_EXTERNAL_MINIME_PATH)/board/common/tiny-base.config"
BR2_LINUX_KERNEL_CONFIG_FRAGMENT_FILES="$(BR2_EXTERNAL_MINIME_PATH)/board/rk3326/tiny-rk3326.config"
BR2_LINUX_KERNEL_DTS_SUPPORT=y
BR2_LINUX_KERNEL_INTREE_DTS_NAME="rockchip/rk3326-anbernic-rg351p rockchip/rk3326-anbernic-rg351m rockchip/rk3326-anbernic-rg351v rockchip/rk3326-anbernic-rg351mp"
BR2_PACKAGE_BUSYBOX_CONFIG_FRAGMENT_FILES="$(BR2_EXTERNAL_MINIME_PATH)/board/common/busybox.config"
BR2_PACKAGE_LIBMALI=y
BR2_PACKAGE_LIBMALI_GPU_BIFROST_G31=y
BR2_PACKAGE_MALI_KBASE=y
BR2_PACKAGE_WIRELESS_REGDB=y
BR2_PACKAGE_WPA_SUPPLICANT=y
BR2_PACKAGE_WPA_SUPPLICANT_CLI=y
BR2_PACKAGE_UTIL_LINUX_PARTX=y
BR2_TARGET_ROOTFS_TAR=y
BR2_TARGET_ARM_TRUSTED_FIRMWARE=y
BR2_TARGET_ARM_TRUSTED_FIRMWARE_CUSTOM_VERSION=y
BR2_TARGET_ARM_TRUSTED_FIRMWARE_CUSTOM_VERSION_VALUE="v2.15.0"
BR2_TARGET_ARM_TRUSTED_FIRMWARE_PLATFORM="px30"
BR2_TARGET_ARM_TRUSTED_FIRMWARE_IMAGES="bl31/bl31.elf"
BR2_TARGET_UBOOT=y
BR2_TARGET_UBOOT_BUILD_SYSTEM_KCONFIG=y
BR2_TARGET_UBOOT_CUSTOM_VERSION=y
BR2_TARGET_UBOOT_CUSTOM_VERSION_VALUE="2026.04"
BR2_TARGET_UBOOT_BOARD_DEFCONFIG="odroid-go2"
BR2_TARGET_UBOOT_CONFIG_FRAGMENT_FILES="$(BR2_EXTERNAL_MINIME_PATH)/board/rk3326/uboot.config"
BR2_TARGET_UBOOT_NEEDS_DTC=y
BR2_TARGET_UBOOT_NEEDS_PYLIBFDT=y
BR2_TARGET_UBOOT_NEEDS_OPENSSL=y
BR2_TARGET_UBOOT_NEEDS_ATF_BL31=y
BR2_TARGET_UBOOT_NEEDS_ATF_BL31_ELF=y
BR2_TARGET_UBOOT_USE_BINMAN=y
BR2_TARGET_UBOOT_FORMAT_ITB=y
BR2_TARGET_UBOOT_SPL=y
BR2_PACKAGE_HOST_EROFS_UTILS=y
BR2_PACKAGE_HOST_GENIMAGE=y
BR2_PACKAGE_HOST_UBOOT_TOOLS=y
BR2_PACKAGE_HOST_MTOOLS=y
BR2_PACKAGE_HOST_DOSFSTOOLS=y

# Bluetooth support
BR2_PACKAGE_DBUS=y
BR2_PACKAGE_BLUEZ5_UTILS=y
BR2_PACKAGE_BLUEZ5_UTILS_CLIENT=y
BR2_PACKAGE_BLUEZ5_UTILS_PLUGINS_HID=y
BR2_PACKAGE_BLUEZ5_UTILS_PLUGINS_AUDIO=y
BR2_PACKAGE_BLUEZ_ALSA=y
BR2_PACKAGE_DOSFSTOOLS=y
BR2_PACKAGE_DOSFSTOOLS_MKFS_FAT=y

# Media and graphics libraries
BR2_PACKAGE_SDL2=y
BR2_PACKAGE_SDL2_KMSDRM=y
BR2_PACKAGE_SDL2_OPENGLES=y
BR2_PACKAGE_SDL2_IMAGE=y
BR2_PACKAGE_SDL2_IMAGE_PNG=y
BR2_PACKAGE_SDL2_TTF=y

# MinUI overlay
BR2_PACKAGE_MINUI=y
BR2_PACKAGE_MINUI_EXTRAS=y
BR2_PACKAGE_DRKHRSE_MIYOO_BEZELS=y
```
