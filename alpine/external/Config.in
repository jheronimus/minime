## buildroot/external/configs/minime_rk3566_defconfig
```kconfig
# Common section: shared across all Minime board images.
# Keep this section identical in minime_h700_defconfig, minime_rk3326_defconfig and minime_rk3566_defconfig.

# Toolchain
BR2_aarch64=y
BR2_TOOLCHAIN_EXTERNAL=y
BR2_TOOLCHAIN_EXTERNAL_ARM_AARCH64=y
BR2_TARGET_LDFLAGS="-fuse-ld=mold"

# Download / cache
BR2_DL_DIR="~/.buildroot-dl"
BR2_DOWNLOAD_FORCE_CHECK_HASHES=y
BR2_CCACHE=y
BR2_CCACHE_DIR="~/.buildroot-ccache"
BR2_CCACHE_INITIAL_SETUP="--max-size=30G"

# Optimisation
BR2_OPTIMIZE_3=y
BR2_ENABLE_LTO=y

# Rootfs base
BR2_TARGET_GENERIC_HOSTNAME="minime"
BR2_ROOTFS_DEVICE_CREATION_DYNAMIC_EUDEV=y
BR2_TARGET_GENERIC_ROOT_PASSWD="root"
BR2_ROOTFS_OVERLAY="$(BR2_EXTERNAL_MINIME_PATH)/board/common/overlay"
BR2_ROOTFS_POST_BUILD_SCRIPT="$(BR2_EXTERNAL_MINIME_PATH)/board/common/post-build.sh"
BR2_ROOTFS_POST_IMAGE_SCRIPT="$(BR2_EXTERNAL_MINIME_PATH)/board/common/post-image.sh"
BR2_TARGET_ROOTFS_TAR=y

# Kernel base
BR2_LINUX_KERNEL=y
BR2_LINUX_KERNEL_CUSTOM_VERSION=y
BR2_LINUX_KERNEL_CUSTOM_VERSION_VALUE="7.0.10"
BR2_LINUX_KERNEL_USE_CUSTOM_CONFIG=y
BR2_LINUX_KERNEL_CUSTOM_CONFIG_FILE="$(BR2_EXTERNAL_MINIME_PATH)/board/common/tiny-base.config"
BR2_LINUX_KERNEL_DTS_SUPPORT=y

# BusyBox
BR2_PACKAGE_BUSYBOX_CONFIG_FRAGMENT_FILES="$(BR2_EXTERNAL_MINIME_PATH)/board/common/busybox.config"

# Bluetooth / Wi-Fi base
BR2_PACKAGE_DBUS=y
BR2_PACKAGE_BLUEZ5_UTILS=y
BR2_PACKAGE_BLUEZ5_UTILS_CLIENT=y
BR2_PACKAGE_BLUEZ5_UTILS_PLUGINS_HID=y
BR2_PACKAGE_BLUEZ5_UTILS_PLUGINS_AUDIO=y
BR2_PACKAGE_BLUEZ_ALSA=y
BR2_PACKAGE_WIRELESS_REGDB=y
BR2_PACKAGE_WPA_SUPPLICANT=y
BR2_PACKAGE_WPA_SUPPLICANT_CLI=y

# Audio
BR2_PACKAGE_ALSA_UTILS=y
# BR2_PACKAGE_ALSA_UTILS_ALSACTL is not set
# BR2_PACKAGE_ALSA_UTILS_ALSAMIXER is not set
BR2_PACKAGE_ALSA_UTILS_AMIXER=y

# Filesystem / partitioning
BR2_PACKAGE_DOSFSTOOLS=y
BR2_PACKAGE_DOSFSTOOLS_MKFS_FAT=y
BR2_PACKAGE_FATRESIZE=y
BR2_PACKAGE_ZSTD=y

# SDL / graphics
BR2_PACKAGE_SDL2=y
BR2_PACKAGE_SDL2_KMSDRM=y
BR2_PACKAGE_SDL2_OPENGLES=y
BR2_PACKAGE_SDL2_IMAGE=y
BR2_PACKAGE_SDL2_IMAGE_PNG=y
BR2_PACKAGE_SDL2_TTF=y
BR2_PACKAGE_LIBPNG=y

# System libraries
BR2_PACKAGE_LIBXML2=y
BR2_PACKAGE_LIBFFI=y
BR2_PACKAGE_LIBEDIT=y

# Network / mDNS
BR2_PACKAGE_MDNSD=y
BR2_PACKAGE_UTIL_LINUX_PARTX=y

# U-Boot base
BR2_TARGET_UBOOT=y
BR2_TARGET_UBOOT_BUILD_SYSTEM_KCONFIG=y
BR2_TARGET_UBOOT_CUSTOM_VERSION=y
BR2_TARGET_UBOOT_CUSTOM_VERSION_VALUE="2026.04"
BR2_TARGET_UBOOT_NEEDS_DTC=y
BR2_TARGET_UBOOT_NEEDS_OPENSSL=y
BR2_TARGET_UBOOT_SPL=y

# Platform specific section: per-board overrides and additional packages.

BR2_cortex_a55=y
BR2_GLOBAL_PATCH_DIR="$(BR2_EXTERNAL_MINIME_PATH)/board/rk3566/patches"
BR2_ROOTFS_POST_SCRIPT_ARGS="-c $(BR2_EXTERNAL_MINIME_PATH)/board/rk3566/genimage.cfg"
BR2_LINUX_KERNEL_CONFIG_FRAGMENT_FILES="$(BR2_EXTERNAL_MINIME_PATH)/board/rk3566/tiny-rk3566.config"
BR2_LINUX_KERNEL_INTREE_DTS_NAME="rockchip/rk3566-anbernic-rg-arc-d rockchip/rk3566-anbernic-rg-arc-s rockchip/rk3566-anbernic-rg353p rockchip/rk3566-anbernic-rg353ps rockchip/rk3566-anbernic-rg353v rockchip/rk3566-anbernic-rg353vs rockchip/rk3566-anbernic-rg503 rockchip/rk3568-anbernic-rg-ds"

BR2_PACKAGE_ROCKCHIP_RKBIN=y
BR2_PACKAGE_ROCKCHIP_RKBIN_TPL_FILENAME="bin/rk35/rk3566_ddr_1056MHz_v1.23.bin"

BR2_TARGET_UBOOT_BOARD_DEFCONFIG="anbernic-rgxx3-rk3566"
BR2_TARGET_UBOOT_CONFIG_FRAGMENT_FILES="$(BR2_EXTERNAL_MINIME_PATH)/board/rk3566/uboot.config"
BR2_TARGET_UBOOT_NEEDS_ROCKCHIP_RKBIN=y
BR2_TARGET_UBOOT_USE_BINMAN=y
BR2_TARGET_UBOOT_FORMAT_ITB=y
BR2_TARGET_UBOOT_CUSTOM_MAKEOPTS="BL31=$(BR2_EXTERNAL_MINIME_PATH)/board/rk3566/prebuilt/rocknix-rkbin/rk3568_bl31_v1.45.elf"

BR2_PACKAGE_LIBMALI=y
BR2_PACKAGE_LIBMALI_GPU_BIFROST_G52=y
BR2_PACKAGE_MALI_KBASE=y
BR2_PACKAGE_ALLIUM=y
BR2_PACKAGE_DRKHRSE_MIYOO_BEZELS=y
BR2_PACKAGE_RETROARCH_CORES=y
```

## buildroot/external/package/allium/Config.in
```kconfig
config BR2_PACKAGE_ALLIUM
	bool "allium"
	depends on BR2_PACKAGE_HOST_GO_TARGET_ARCH_SUPPORTS
	depends on BR2_PACKAGE_HOST_RUSTC_TARGET_ARCH_SUPPORTS
	select BR2_PACKAGE_ALLIUM_THEMES
	select BR2_PACKAGE_DUFS
	select BR2_PACKAGE_HOST_LIBCLANG_SYSTEM
	select BR2_PACKAGE_HOST_RUSTC
	select BR2_PACKAGE_LIBRETRO_HEADERS
	select BR2_PACKAGE_SYNCTHING
	help
	  Allium launcher and Play libretro frontend for Minime.

	  https://github.com/jheronimus/Allium

comment "allium needs Go- and Rust-supported targets"
	depends on !BR2_PACKAGE_HOST_GO_TARGET_ARCH_SUPPORTS || !BR2_PACKAGE_HOST_RUSTC_TARGET_ARCH_SUPPORTS
```

## buildroot/external/package/bootsplash/Config.in
```kconfig
config BR2_PACKAGE_BOOTSPLASH
	bool "bootsplash"
	select BR2_PACKAGE_SDL2
	help
	  Animated boot splash for Minime with synthesized audio.
	  Mimics Game Boy family boots using the minimē wordmark.
```

## buildroot/external/package/geekbench/Config.in
```kconfig
config BR2_PACKAGE_GEEKBENCH
	bool "geekbench"
	depends on BR2_aarch64
	help
	  Geekbench 6 is a cross-platform benchmark that measures
	  your system's performance.

	  https://www.geekbench.com/
```

## buildroot/external/package/libclang-system/Config.in
```kconfig
config BR2_PACKAGE_HOST_LIBCLANG_SYSTEM
	bool "host libclang (system)"
	select BR2_PACKAGE_HOST_LLVM_SYSTEM
	help
	  Use the Debian build container's preinstalled libclang libraries
	  (LLVM 22 from apt.llvm.org) instead of building host-clang from
	  source.

	  Requires libclang1-22 and libclang-cpp22 to be installed in the
	  container image.
```

## buildroot/external/package/libmali/Config.in
```kconfig
config BR2_PACKAGE_LIBMALI
	bool "libmali"
	depends on BR2_aarch64
	depends on !BR2_PACKAGE_MESA3D_GALLIUM_DRIVER_PANFROST
	select BR2_PACKAGE_HAS_LIBEGL
	select BR2_PACKAGE_HAS_LIBGLES
	select BR2_PACKAGE_HAS_LIBGBM
	select BR2_PACKAGE_LIBDRM
	help
	  Proprietary ARM Mali user-space driver wrappers.
	  Provides OpenGL ES, EGL, and GBM libraries.

if BR2_PACKAGE_LIBMALI

choice
	prompt "Mali GPU Variant"
	default BR2_PACKAGE_LIBMALI_BIFROST_G31_G24P0
	help
	  Select the specific Mali GPU model and driver version variant.

config BR2_PACKAGE_LIBMALI_BIFROST_G31_G24P0
	bool "Bifrost G31 G24P0 (H700)"

config BR2_PACKAGE_LIBMALI_BIFROST_G31_G13P0
	bool "Bifrost G31 G13P0 (RK3326)"

config BR2_PACKAGE_LIBMALI_BIFROST_G31_G2P0
	bool "Bifrost G31 G2P0 (RK3326)"

config BR2_PACKAGE_LIBMALI_BIFROST_G52_G13P0
	bool "Bifrost G52 G13P0 (RK3566)"

config BR2_PACKAGE_LIBMALI_BIFROST_G52_G24P0
	bool "Bifrost G52 G24P0 (RK3566)"

config BR2_PACKAGE_LIBMALI_BIFROST_G52_G2P0
	bool "Bifrost G52 G2P0 (RK3566)"

endchoice

config BR2_PACKAGE_LIBMALI_GPU
	string
	default "bifrost-g31" if BR2_PACKAGE_LIBMALI_BIFROST_G31_G24P0 || BR2_PACKAGE_LIBMALI_BIFROST_G31_G13P0 || BR2_PACKAGE_LIBMALI_BIFROST_G31_G2P0
	default "bifrost-g52" if BR2_PACKAGE_LIBMALI_BIFROST_G52_G13P0 || BR2_PACKAGE_LIBMALI_BIFROST_G52_G24P0 || BR2_PACKAGE_LIBMALI_BIFROST_G52_G2P0

config BR2_PACKAGE_LIBMALI_GPU_VERSION
	string
	default "g24p0" if BR2_PACKAGE_LIBMALI_BIFROST_G31_G24P0 || BR2_PACKAGE_LIBMALI_BIFROST_G52_G24P0
	default "g13p0" if BR2_PACKAGE_LIBMALI_BIFROST_G31_G13P0 || BR2_PACKAGE_LIBMALI_BIFROST_G52_G13P0
	default "g2p0" if BR2_PACKAGE_LIBMALI_BIFROST_G31_G2P0 || BR2_PACKAGE_LIBMALI_BIFROST_G52_G2P0

config BR2_PACKAGE_PROVIDES_LIBEGL
	default "libmali"

config BR2_PACKAGE_PROVIDES_LIBGLES
	default "libmali"

config BR2_PACKAGE_PROVIDES_LIBGBM
	default "libmali"

endif
```

## buildroot/external/package/libretro-cores/Config.in
```kconfig
config BR2_PACKAGE_LIBRETRO_CORES
	bool "libretro-cores"
	select BR2_PACKAGE_ZLIB
	help
	  Centralized RetroArch/libretro cores package for minime.
	  Builds a set of popular cores from source.
```

## buildroot/external/package/libretro-headers/Config.in
```kconfig
config BR2_PACKAGE_LIBRETRO_HEADERS
	bool
	help
	  Build-time libretro API header package pinned to the libretro-common
	  commit aligned with the tracked RetroArch stable release.
```

## buildroot/external/package/mesa3d-panfrost-prebuilt/Config.in
```kconfig
config BR2_PACKAGE_MESA3D_PANFROST_PREBUILT
	bool "mesa3d-panfrost-prebuilt"
	depends on BR2_aarch64
	select BR2_PACKAGE_HAS_LIBEGL
	select BR2_PACKAGE_HAS_LIBGLES
	select BR2_PACKAGE_HAS_LIBGBM
	select BR2_PACKAGE_LIBDRM
	select BR2_PACKAGE_MESA3D_HEADERS
	help
	  Precompiled Mesa (Panfrost) + LLVM binaries for dynamic switching.

if BR2_PACKAGE_MESA3D_PANFROST_PREBUILT

config BR2_PACKAGE_PROVIDES_LIBEGL
	default "mesa3d-panfrost-prebuilt"

config BR2_PACKAGE_PROVIDES_LIBGLES
	default "mesa3d-panfrost-prebuilt"

config BR2_PACKAGE_PROVIDES_LIBGBM
	default "mesa3d-panfrost-prebuilt"

endif
```

## buildroot/external/package/minime-prebuilt-llvm/Config.in
```kconfig
config BR2_PACKAGE_MINIME_PREBUILT_LLVM
	bool "Minime prebuilt LLVM package set"
	help
	  Import Buildroot-built LLVM/Clang/libclc/SPIR-V package outputs
	  from jheronimus/minime instead of rebuilding them locally.

config BR2_PACKAGE_MINIME_PREBUILT_LLVM_CHANNEL_URL
	string "Prebuilt LLVM channel manifest URL"
	depends on BR2_PACKAGE_MINIME_PREBUILT_LLVM
	default "https://raw.githubusercontent.com/jheronimus/minime/llvm-channels/channels/bootlin-musl/2026.05.1/stable.json"
	help
	  URL of a stable.json manifest. The manifest points at the
	  assembled llvm-rN.tar.xz artifact (named by "asset" / "url" and
	  verified against the top-level "sha256") and, when the assembled
	  archive exceeds GitHub's 2 GiB release-asset cap, includes a
	  "parts" array describing each chunk; the fetcher reassembles the
	  chunks before extraction.

config BR2_PACKAGE_MINIME_PREBUILT_LLVM_FLAVOR
	string "Prebuilt LLVM flavor"
	depends on BR2_PACKAGE_MINIME_PREBUILT_LLVM
	help
	  The flavor of the toolchain (e.g. bootlin-musl, arm-glibc)
```

## buildroot/external/package/minui/Config.in
```kconfig
################################################################################
#
# minui
#
################################################################################

config BR2_PACKAGE_MINUI
	bool "minui"
	select BR2_PACKAGE_DBUS
	select BR2_PACKAGE_LZ4
	select BR2_PACKAGE_SDL2
	select BR2_PACKAGE_SDL2_IMAGE
	select BR2_PACKAGE_SDL2_TTF
	select BR2_PACKAGE_ZLIB
	help
	  MinUI launcher frontend and UI shell for minime.
	  Fetches prebuilt release zips from GitHub.

	  https://github.com/jheronimus/MinUI
```
