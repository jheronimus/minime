## buildroot/external/package/panfrost/Config.in
```kconfig
config BR2_PACKAGE_PANFROST
	bool "panfrost"
	depends on BR2_aarch64
	select BR2_PACKAGE_HAS_LIBEGL
	select BR2_PACKAGE_HAS_LIBGLES
	select BR2_PACKAGE_HAS_LIBGBM
	select BR2_PACKAGE_LIBDRM
	select BR2_PACKAGE_MESA3D_HEADERS
	select BR2_PACKAGE_ZSTD
	select BR2_PACKAGE_LIBXML2
	select BR2_PACKAGE_LIBFFI
	select BR2_PACKAGE_LIBEDIT
	select BR2_PACKAGE_Z3
	help
	  Precompiled Mesa (Panfrost) + LLVM binaries
	  for dynamic switching.

if BR2_PACKAGE_PANFROST

config BR2_PACKAGE_PROVIDES_LIBEGL
	default "panfrost"

config BR2_PACKAGE_PROVIDES_LIBGLES
	default "panfrost"

config BR2_PACKAGE_PROVIDES_LIBGBM
	default "panfrost"

endif
```

## buildroot/external/package/retroarch/Config.in
```kconfig
config BR2_PACKAGE_RETROARCH
	bool "retroarch"
	select BR2_PACKAGE_LIBRETRO_CORES
	select BR2_PACKAGE_SDL2
	select BR2_PACKAGE_SDL2_KMSDRM
	select BR2_PACKAGE_SDL2_OPENGLES
	select BR2_PACKAGE_ALSA_LIB
	select BR2_PACKAGE_ZLIB
	help
	  RetroArch frontend for minime.
```

## external/Config.in
```kconfig
source "$BR2_EXTERNAL_MINIME_PATH/package/libmali/Config.in"
source "$BR2_EXTERNAL_MINIME_PATH/package/mali-kbase/Config.in"
source "$BR2_EXTERNAL_MINIME_PATH/package/minui/Config.in"
source "$BR2_EXTERNAL_MINIME_PATH/package/drkhrse_miyoo_bezels/Config.in"
```

## external/configs/minime_defconfig
```kconfig
BR2_aarch64=y
BR2_TOOLCHAIN_EXTERNAL=y
BR2_TOOLCHAIN_EXTERNAL_ARM_AARCH64=y
BR2_TARGET_LDFLAGS="-fuse-ld=mold"
BR2_DL_DIR="~/.buildroot-dl"
BR2_CCACHE=y
BR2_CCACHE_DIR="~/.buildroot-ccache"
BR2_CCACHE_INITIAL_SETUP="--max-size=30G"
BR2_OPTIMIZE_3=y
BR2_ENABLE_LTO=y
BR2_GLOBAL_PATCH_DIR="$(BR2_EXTERNAL_MINIME_PATH)/board/rg35xxsp/patches"
BR2_TARGET_GENERIC_HOSTNAME="minime"
BR2_ROOTFS_DEVICE_CREATION_DYNAMIC_EUDEV=y
BR2_TARGET_GENERIC_ROOT_PASSWD="root"
BR2_ROOTFS_OVERLAY="$(BR2_EXTERNAL_MINIME_PATH)/board/rg35xxsp/overlay"
BR2_ROOTFS_POST_BUILD_SCRIPT="$(BR2_EXTERNAL_MINIME_PATH)/board/rg35xxsp/post-build.sh"
BR2_ROOTFS_POST_IMAGE_SCRIPT="$(BR2_EXTERNAL_MINIME_PATH)/board/rg35xxsp/post-image.sh"
BR2_ROOTFS_POST_SCRIPT_ARGS="-c $(BR2_EXTERNAL_MINIME_PATH)/board/rg35xxsp/genimage.cfg"
BR2_LINUX_KERNEL=y
BR2_LINUX_KERNEL_CUSTOM_VERSION=y
BR2_LINUX_KERNEL_CUSTOM_VERSION_VALUE="7.0.10"
BR2_LINUX_KERNEL_USE_CUSTOM_CONFIG=y
BR2_LINUX_KERNEL_CUSTOM_CONFIG_FILE="$(BR2_EXTERNAL_MINIME_PATH)/board/rg35xxsp/linux.config"
BR2_LINUX_KERNEL_DTS_SUPPORT=y
BR2_LINUX_KERNEL_INTREE_DTS_NAME="allwinner/sun50i-h700-anbernic-rg35xx-sp"
BR2_PACKAGE_BUSYBOX_CONFIG_FRAGMENT_FILES="$(BR2_EXTERNAL_MINIME_PATH)/board/rg35xxsp/busybox.config"
BR2_PACKAGE_LIBMALI=y
BR2_PACKAGE_MALI_KBASE=y
BR2_PACKAGE_F2FS_TOOLS=y
BR2_PACKAGE_LINUX_FIRMWARE=y
BR2_PACKAGE_LINUX_FIRMWARE_RTL_88XX_BT=y
BR2_PACKAGE_LINUX_FIRMWARE_RTL_RTW88=y
BR2_PACKAGE_WIRELESS_REGDB=y
BR2_PACKAGE_WPA_SUPPLICANT=y
BR2_PACKAGE_WPA_SUPPLICANT_CLI=y
BR2_PACKAGE_UTIL_LINUX_BINARIES=y
BR2_PACKAGE_UTIL_LINUX_PARTX=y
BR2_PACKAGE_UTIL_LINUX_RFKILL=y
BR2_TARGET_ROOTFS_TAR=y
BR2_TARGET_ARM_TRUSTED_FIRMWARE=y
BR2_TARGET_ARM_TRUSTED_FIRMWARE_PLATFORM="sun50i_h616"
BR2_TARGET_UBOOT=y
BR2_TARGET_UBOOT_BUILD_SYSTEM_KCONFIG=y
BR2_TARGET_UBOOT_CUSTOM_VERSION=y
BR2_TARGET_UBOOT_CUSTOM_VERSION_VALUE="2026.04"
BR2_TARGET_UBOOT_BOARD_DEFCONFIG="anbernic_rg35xx_h700"
BR2_TARGET_UBOOT_CONFIG_FRAGMENT_FILES="$(BR2_EXTERNAL_MINIME_PATH)/board/rg35xxsp/uboot.config"
BR2_TARGET_UBOOT_NEEDS_DTC=y
BR2_TARGET_UBOOT_NEEDS_PYLIBFDT=y
BR2_TARGET_UBOOT_NEEDS_OPENSSL=y
BR2_TARGET_UBOOT_NEEDS_ATF_BL31=y
BR2_TARGET_UBOOT_SPL=y
BR2_TARGET_UBOOT_SPL_NAME="u-boot-sunxi-with-spl.bin"
BR2_PACKAGE_HOST_EROFS_UTILS=y
BR2_PACKAGE_HOST_GENIMAGE=y
BR2_PACKAGE_HOST_UBOOT_TOOLS=y
BR2_PACKAGE_HOST_MTOOLS=y
BR2_PACKAGE_HOST_DOSFSTOOLS=y
```

## external/package/drkhrse_miyoo_bezels/Config.in
```kconfig
config BR2_PACKAGE_DRKHRSE_MIYOO_BEZELS
	bool "drkhrse_miyoo_bezels"
	help
	  Miyoo Mini bezels from drkhrse.

	  https://github.com/drkhrse/drkhrse_miyoo_bezels
```

## external/package/minui/Config.in
```kconfig
config BR2_PACKAGE_MINUI
	bool "minui"
	help
	  MinUI firmware overlay for minime.

	  https://github.com/shauninman/MinUI

if BR2_PACKAGE_MINUI

config BR2_PACKAGE_MINUI_EXTRAS
	bool "Include MinUI Extras"
	default y
	help
	  Build and stage additional emulators and tools from MinUI Extras.

endif
```

## external/package/preloaded-roms/Config.in
```kconfig
config BR2_PACKAGE_PRELOADED_ROMS
	bool "preloaded-roms"
	help
	  Preloaded free and homebrew ROMs for MinUI/RetroArch.

	  https://github.com/jheronimus/preloaded-roms
```

## minime/targets/buildroot/external/package/allium/Config.in
```kconfig
config BR2_PACKAGE_ALLIUM
	bool "Allium"
	help
	  Allium launcher frontend (prebuilt from releases).
```

## minime/targets/buildroot/external/package/fatresize/Config.in
```kconfig
config BR2_PACKAGE_FATRESIZE
	bool "fatresize"
	depends on BR2_ENABLE_LOCALE
	depends on BR2_USE_WCHAR
	depends on BR2_TOOLCHAIN_GCC_AT_LEAST_5
	select BR2_PACKAGE_PARTED
	help
	  Non-destructively resize FAT16 and FAT32 filesystems.

	  https://github.com/ya-mouse/fatresize

comment "fatresize needs a toolchain w/ locale, wchar, gcc >= 5"
	depends on !BR2_ENABLE_LOCALE || !BR2_USE_WCHAR || \
		!BR2_TOOLCHAIN_GCC_AT_LEAST_5
```

## packages/components/buildroot/external/package/dufs/Config.in
```kconfig
config BR2_PACKAGE_DUFS
	bool "dufs"
	depends on BR2_PACKAGE_HOST_RUSTC_TARGET_ARCH_SUPPORTS
	select BR2_PACKAGE_HOST_RUSTC
	help
	  File server with WebDAV support.

	  https://github.com/sigoden/dufs

comment "dufs needs a Rust-supported target"
	depends on !BR2_PACKAGE_HOST_RUSTC_TARGET_ARCH_SUPPORTS
```

## packages/components/buildroot/external/package/syncthing/Config.in
```kconfig
config BR2_PACKAGE_SYNCTHING
	bool "syncthing"
	depends on BR2_PACKAGE_HOST_GO_TARGET_ARCH_SUPPORTS
	select BR2_PACKAGE_HOST_GO
	help
	  Continuous file synchronization.

	  https://github.com/syncthing/syncthing

comment "syncthing needs a Go-supported target"
	depends on !BR2_PACKAGE_HOST_GO_TARGET_ARCH_SUPPORTS
```
