## minime/targets/buildroot/external/Config.in
```kconfig
source "$BR2_EXTERNAL_MINIME_PATH/package/libretro-headers/Config.in"
source "$BR2_EXTERNAL_MINIME_PATH/package/libmali/Config.in"
source "$BR2_EXTERNAL_MINIME_PATH/package/mali-kbase/Config.in"


source "$BR2_EXTERNAL_MINIME_PATH/package/fatresize/Config.in"

source "$BR2_EXTERNAL_MINIME_PATH/package/drkhrse-miyoo-bezels/Config.in"

source "$BR2_EXTERNAL_MINIME_PATH/package/libretro-cores/Config.in"
source "$BR2_EXTERNAL_MINIME_PATH/package/retroarch/Config.in"
```

## minime/targets/buildroot/external/package/benchmark/Config.in
```kconfig
config BR2_PACKAGE_BENCHMARK
	bool "benchmark"
	help
	  Minime performance benchmark suite.
```

## minime/targets/buildroot/external/package/minime-rotate/Config.in
```kconfig
config BR2_PACKAGE_MINIME_ROTATE
	bool "minime-rotate"
	help
	  Minime display overlay helper: set/query the DRM/KMS primary-plane
	  rotation (RK3566 VOP2 hardware rotation) from the device traits.
```

## packages/components/buildroot/external/package/bootsplash/Config.in
```kconfig
config BR2_PACKAGE_BOOTSPLASH
	bool "bootsplash"
	help
	  Minime lightweight framebuffer bootsplash daemon.
```

## packages/components/buildroot/external/package/bt-mirror/Config.in
```kconfig
config BR2_PACKAGE_BT_MIRROR
	bool "bt-mirror"
	select BR2_PACKAGE_ALSA_LIB
	select BR2_PACKAGE_ALSA_UTILS
	select BR2_PACKAGE_BLUEZ_ALSA
	help
	  Minime Bluetooth audio mirror helper.
```

## packages/components/buildroot/external/package/remote/Config.in
```kconfig
config BR2_PACKAGE_REMOTE
	bool "remote"
	help
	  Minime remote screenshot and input simulation tool.
```
